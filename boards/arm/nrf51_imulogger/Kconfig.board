## boards/arm/nrf51_imulogger/Kconfig.board
```kconfig
# Kconfig - nRF51 IMULOGGER board configuration
#
# Copyright (c) 2016 Linaro Limited.
#
# SPDX-License-Identifier: Apache-2.0

config BOARD_NRF51_IMULOGGER
	bool "nRF51 IMULOGGER"
	depends on SOC_NRF51822_QFAA
```

## boards/arm/nrf51_imulogger/Kconfig.defconfig
```kconfig
# Kconfig - nRF51 IMULOGGER board configuration
#
# Copyright (c) 2016 Linaro Limited.
#
# SPDX-License-Identifier: Apache-2.0

if BOARD_NRF51_IMULOGGER

config BOARD
	default "nrf51_imulogger"

if ADC

config ADC_0
	default y

endif # ADC

if I2C

config I2C_0
	default y

endif # I2C

if SPI

config SPI_1
	default y

endif # SPI

config BT_CTLR
	default BT

endif # BOARD_NRF51_IMULOGGER
```

## main/Kconfig.projbuild
```kconfig
menu "imulogger config"

config IMULOGGER_SENTRAL_PASSTHROUGH
    bool "use sentral passthrough mode"

endmenu
```

## sdkconfig.defaults
```kconfig
CONFIG_FREERTOS_SUPPORT_STATIC_ALLOCATION=y
CONFIG_FATFS_LFN_HEAP=y
CONFIG_COMPILER_OPTIMIZATION_LEVEL_RELEASE=y
CONFIG_ESP_MAIN_TASK_STACK_SIZE=8192

# brownout detector
CONFIG_ESP32_BROWNOUT_DET=y
CONFIG_ESP32_BROWNOUT_DET_LVL_SEL_6=y

# USFS
CONFIG_IMULOGGER_SENTRAL_PASSTHROUGH=y

# usfs needs to be the only one on cpu1
CONFIG_LWIP_TCPIP_TASK_AFFINITY_CPU0=y

#
# network performance optimizations
#

CONFIG_ESP_SYSTEM_EVENT_TASK_STACK_SIZE=4096

CONFIG_ESP32_WIFI_STATIC_RX_BUFFER_NUM=16
CONFIG_ESP32_WIFI_DYNAMIC_RX_BUFFER_NUM=64
CONFIG_ESP32_WIFI_DYNAMIC_TX_BUFFER_NUM=64
CONFIG_ESP32_WIFI_AMPDU_TX_ENABLED=y
CONFIG_ESP32_WIFI_TX_BA_WIN=32
CONFIG_ESP32_WIFI_AMPDU_RX_ENABLED=y
CONFIG_ESP32_WIFI_RX_BA_WIN=32

CONFIG_FREERTOS_HZ=1000

CONFIG_LWIP_TCP_SND_BUF_DEFAULT=65534
CONFIG_LWIP_TCP_WND_DEFAULT=65534
CONFIG_LWIP_TCP_RECVMBOX_SIZE=64
CONFIG_LWIP_UDP_RECVMBOX_SIZE=64
CONFIG_LWIP_TCPIP_RECVMBOX_SIZE=64

CONFIG_LWIP_IRAM_OPTIMIZATION=y
```
